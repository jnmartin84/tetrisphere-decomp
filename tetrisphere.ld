SECTIONS
{
    __romPos = 0;
    header_ROM_START = __romPos;
    header_VRAM = ADDR(.header);
    .header : AT(header_ROM_START) SUBALIGN(16)
    {
        FILL(0x00000000);
        header_DATA_START = .;
        build/asm/header.o(.data);
        header_DATA_END = .;
        header_DATA_SIZE = ABSOLUTE(header_DATA_END - header_DATA_START);
    }
    __romPos += SIZEOF(.header);
    header_ROM_END = __romPos;
    header_VRAM_END = .;

    ipl3_ROM_START = __romPos;
    ipl3_VRAM = ADDR(.ipl3);
    .ipl3 : AT(ipl3_ROM_START) SUBALIGN(16)
    {
        FILL(0x00000000);
        ipl3_DATA_START = .;
        build/assets/ipl3.o(.data);
        ipl3_DATA_END = .;
        ipl3_DATA_SIZE = ABSOLUTE(ipl3_DATA_END - ipl3_DATA_START);
    }
    __romPos += SIZEOF(.ipl3);
    ipl3_ROM_END = __romPos;
    ipl3_VRAM_END = .;

    entry_ROM_START = __romPos;
    entry_VRAM = ADDR(.entry);
    .entry 0x80025C50 : AT(entry_ROM_START) SUBALIGN(16)
    {
        FILL(0x00000000);
        entry_TEXT_START = .;
        build/asm/1000.o(.text);
        . = ALIGN(., 16);
        entry_TEXT_END = .;
        entry_TEXT_SIZE = ABSOLUTE(entry_TEXT_END - entry_TEXT_START);
        entry_DATA_START = .;
        build/asm/1000.o(.data);
        . = ALIGN(., 16);
        entry_DATA_END = .;
        entry_DATA_SIZE = ABSOLUTE(entry_DATA_END - entry_DATA_START);
        entry_RODATA_START = .;
        build/asm/1000.o(.rodata);
        . = ALIGN(., 16);
        entry_RODATA_END = .;
        entry_RODATA_SIZE = ABSOLUTE(entry_RODATA_END - entry_RODATA_START);
    }
    entry_bss_VRAM = ADDR(.entry_bss);
    .entry_bss (NOLOAD) : SUBALIGN(16)
    {
        FILL(0x00000000);
        entry_BSS_START = .;
        build/asm/1000.o(.bss);
        . = ALIGN(., 16);
        entry_BSS_END = .;
        entry_BSS_SIZE = ABSOLUTE(entry_BSS_END - entry_BSS_START);
    }
    __romPos += SIZEOF(.entry);
    __romPos = ALIGN(__romPos, 16);
    . = ALIGN(., 16);
    entry_ROM_END = __romPos;
    entry_VRAM_END = .;

    main_ROM_START = __romPos;
    main_VRAM = ADDR(.main);
    .main entry_VRAM_END : AT(main_ROM_START) SUBALIGN(4)
    {
        FILL(0x00000000);
        main_TEXT_START = .;
        build/src/code_1050.o(.text);
        build/src/n_audio/env.o(.text);
        build/src/sched.o(.text);
        build/src/boot.o(.text);
        build/src/controller.o(.text);
        build/src/code_62D0.o(.text);
        build/src/code_8170.o(.text);
        build/src/util.o(.text);
        build/src/rdpinit.o(.text);
        build/src/main.o(.text);
        build/src/code_4D170.o(.text);
        build/src/code_54150.o(.text);
        build/src/lz.o(.text);
        build/src/synsetvol.o(.text);
        build/src/audio_engine.o(.text);
        build/src/audiomgr.o(.text);
        build/src/audio.o(.text);
        build/src/code_5B5D0.o(.text);
        build/src/rand.o(.text);
        build/src/game2.o(.text);
        build/src/code_AB540.o(.text);
        build/asm/code_AB7E0.o(.text);
        build/asm/code_AB830.o(.text);
        build/asm/code_AB860.o(.text);
        build/src/n_audio/sl.o(.text);
        build/src/n_audio/synthesizer.o(.text);
        build/src/libultra/os/virtualtophysical.o(.text);
        build/src/libultra/os/createmesgqueue.o(.text);
        build/src/libultra/io/vimgr.o(.text);
        build/src/libultra/io/visetmode.o(.text);
        build/src/libultra/io/viblack.o(.text);
        build/src/libultra/os/seteventmesg.o(.text);
        build/src/libultra/io/visetevent.o(.text);
        build/src/libultra/os/createthread.o(.text);
        build/src/libultra/os/startthread.o(.text);
        build/asm/libultra/os/setintmask.o(.text);
        build/src/libultra/os/recvmesg.o(.text);
        build/src/libultra/os/sendmesg.o(.text);
        build/src/libultra/io/sptaskyielded.o(.text);
        build/src/libultra/io/vigetcurrframebuf.o(.text);
        build/src/libultra/io/vigetnextframebuf.o(.text);
        build/src/libultra/io/viswapbuf.o(.text);
        build/asm/libultra/os/writebackdcacheall.o(.text);
        build/src/libultra/io/sptask.o(.text);
        build/src/libultra/io/dpsetnextbuf.o(.text);
        build/src/libultra/io/sptaskyield.o(.text);
        build/asm/code_AD110.o(.text);
        build/src/libultra/os/initialize.o(.text);
        build/src/libultra/io/pirawread.o(.text);
        build/src/libultra/os/getcurrfaultthread.o(.text);
        build/src/libultra/io/pimgr.o(.text);
        build/src/libultra/os/setthreadpri.o(.text);
        build/src/libultra/io/conteepwrite.o(.text);
        build/src/libultra/io/conteepread.o(.text);
        build/src/libultra/io/contreaddata.o(.text);
        build/src/libultra/io/conteepprobe.o(.text);
        build/asm/libultra/os/invaldcache.o(.text);
        build/src/libultra/io/pidma.o(.text);
        build/src/libultra/io/visetspecial.o(.text);
        build/src/libultra/libc/sprintf.o(.text);
        build/src/libultra/io/controller.o(.text);
        build/src/libultra/libc/string.o(.text);
        build/src/libultra/libc/syncprintf.o(.text);
        build/src/libultra/os/stopthread.o(.text);
        build/src/libultra/libc/ll.o(.text);
        build/src/libultra/os/settime.o(.text);
        build/asm/libultra/libc/bzero.o(.text);
        build/src/libultra/gu/cosf.o(.text);
        build/src/libultra/gu/sinf.o(.text);
        build/src/libultra/gu/mtxutil.o(.text);
        build/src/libultra/gu/translate.o(.text);
        build/src/libultra/gu/mtxcatf.o(.text);
        build/src/libultra/gu/rotate.o(.text);
        build/src/libultra/gu/scale.o(.text);
        build/src/libultra/gu/perspective.o(.text);
        build/src/libultra/gu/lookatref.o(.text);
        build/src/libultra/gu/sins.o(.text);
        build/src/libultra/gu/rotaterpy.o(.text);
        build/src/libultra/gu/coss.o(.text);
        build/src/libultra/gu/ortho.o(.text);
        build/asm/libultra/gu/sqrtf.o(.text);
        build/src/libultra/audio/synaddplayer.o(.text);
        build/src/libultra/audio/synallocvoice.o(.text);
        build/src/libultra/audio/synstopvoice.o(.text);
        build/src/libultra/os/jammesg.o(.text);
        build/src/libultra/audio/synsetpan.o(.text);
        build/src/libultra/audio/synstartvoiceparam.o(.text);
        build/src/libultra/audio/synsetpitch.o(.text);
        build/src/libultra/io/aisetfreq.o(.text);
        build/src/libultra/audio/heapalloc.o(.text);
        build/src/libultra/io/aisetnextbuf.o(.text);
        build/src/libultra/io/aigetlen.o(.text);
        build/src/libultra/audio/heapinit.o(.text);
        build/src/libultra/gu/lookat.o(.text);
        build/asm/libultra/os/writebackdcache.o(.text);
        build/src/libultra/os/gettime.o(.text);
        build/src/libultra/audio/syndelete.o(.text);
        build/src/libultra/audio/drvrnew.o(.text);
        build/src/libultra/audio/synallocfx.o(.text);
        build/src/libultra/audio/mainbus.o(.text);
        build/src/libultra/audio/resample.o(.text);
        build/src/libultra/audio/auxbus.o(.text);
        build/src/libultra/audio/save.o(.text);
        build/asm/libultra/os/probetlb.o(.text);
        build/src/libultra/os/thread.o(.text);
        build/src/libultra/os/timerintr.o(.text);
        build/src/libultra/os/getthreadpri.o(.text);
        build/asm/libultra/os/interrupt.o(.text);
        build/src/libultra/io/vi.o(.text);
        build/src/libultra/io/vigetcurrcontext.o(.text);
        build/src/libultra/io/viswapcontext.o(.text);
        build/asm/libultra/os/getcount.o(.text);
        build/asm/libultra/os/exceptasm.o(.text);
        build/src/libultra/io/spgetstat.o(.text);
        build/asm/libultra/libc/bcopy.o(.text);
        build/src/libultra/io/spsetstat.o(.text);
        build/src/libultra/io/spsetpc.o(.text);
        build/src/libultra/io/sprawdma.o(.text);
        build/src/libultra/io/sp.o(.text);
        build/src/libultra/io/dp.o(.text);
        build/asm/libultra/os/setsr.o(.text);
        build/asm/libultra/os/setfpccsr.o(.text);
        build/src/libultra/io/siraw.o(.text);
        build/asm/libultra/os/invalicache.o(.text);
        build/asm/libultra/os/maptlbrdb.o(.text);
        build/src/libultra/io/cartrominit.o(.text);
        build/src/libultra/io/leodiskinit.o(.text);
        build/src/libultra/io/piacs.o(.text);
        build/src/libultra/io/pirawdma.o(.text);
        build/src/libultra/io/epirawdma.o(.text);
        build/src/libultra/io/devmgr.o(.text);
        build/src/libultra/io/siacs.o(.text);
        build/src/libultra/io/sirawdma.o(.text);
        build/src/libultra/io/pigetcmdq.o(.text);
        build/src/libultra/libc/xprintf.o(.text);
        build/src/libultra/os/settimer.o(.text);
        build/src/libultra/gu/normalize.o(.text);
        build/src/libultra/io/ai.o(.text);
        build/src/libultra/audio/filter.o(.text);
        build/src/libultra/audio/reverb.o(.text);
        build/src/libultra/audio/load.o(.text);
        build/asm/libultra/os/setcompare.o(.text);
        build/src/libultra/io/leointerrupt.o(.text);
        build/src/libultra/os/destroythread.o(.text);
        build/src/libultra/io/si.o(.text);
        build/src/libultra/os/resetglobalintmask.o(.text);
        build/src/libultra/io/epirawwrite.o(.text);
        build/src/libultra/io/epirawread.o(.text);
        build/src/libultra/os/setglobalintmask.o(.text);
        build/src/libultra/os/yieldthread.o(.text);
        build/src/libultra/libc/xlitob.o(.text);
        build/src/libultra/libc/xldtob.o(.text);
        build/src/libultra/audio/copy.o(.text);
        build/src/libultra/libc/ldiv.o(.text);
        build/asm/ucode.o(.text);
        . = ALIGN(., 16);
        main_TEXT_END = .;
        main_TEXT_SIZE = ABSOLUTE(main_TEXT_END - main_TEXT_START);
        main_DATA_START = .;
        build/src/code_1050.o(.data);
        build/asm/data/B8880.data.o(.data);
        build/src/n_audio/env.o(.data);
        build/src/sched.o(.data);
        build/src/boot.o(.data);
        build/src/controller.o(.data);
        build/src/code_62D0.o(.data);
        build/src/code_8170.o(.data);
        build/src/util.o(.data);
        build/src/rdpinit.o(.data);
        build/src/main.o(.data);
        build/src/code_4D170.o(.data);
        build/src/code_54150.o(.data);
        build/src/lz.o(.data);
        build/src/synsetvol.o(.data);
        build/src/audio_engine.o(.data);
        build/src/audiomgr.o(.data);
        build/src/audio.o(.data);
        build/src/code_5B5D0.o(.data);
        build/src/rand.o(.data);
        build/asm/data/BAAB0.data.o(.data);
        build/src/game2.o(.data);
        build/src/code_AB540.o(.data);
        build/asm/code_AB7E0.o(.data);
        build/asm/code_AB830.o(.data);
        build/asm/code_AB860.o(.data);
        build/src/n_audio/sl.o(.data);
        build/src/n_audio/synthesizer.o(.data);
        build/src/libultra/os/virtualtophysical.o(.data);
        build/src/libultra/os/createmesgqueue.o(.data);
        build/asm/data/C2060.data.o(.data);
        build/src/libultra/io/vimgr.o(.data);
        build/src/libultra/io/visetmode.o(.data);
        build/src/libultra/io/viblack.o(.data);
        build/src/libultra/os/seteventmesg.o(.data);
        build/src/libultra/io/visetevent.o(.data);
        build/src/libultra/os/createthread.o(.data);
        build/src/libultra/os/startthread.o(.data);
        build/asm/libultra/os/setintmask.o(.data);
        build/src/libultra/os/recvmesg.o(.data);
        build/src/libultra/os/sendmesg.o(.data);
        build/src/libultra/io/sptaskyielded.o(.data);
        build/src/libultra/io/vigetcurrframebuf.o(.data);
        build/src/libultra/io/vigetnextframebuf.o(.data);
        build/src/libultra/io/viswapbuf.o(.data);
        build/asm/libultra/os/writebackdcacheall.o(.data);
        build/src/libultra/io/sptask.o(.data);
        build/src/libultra/io/dpsetnextbuf.o(.data);
        build/src/libultra/io/sptaskyield.o(.data);
        build/asm/code_AD110.o(.data);
        build/src/libultra/os/initialize.o(.data);
        build/src/libultra/io/pirawread.o(.data);
        build/src/libultra/os/getcurrfaultthread.o(.data);
        build/src/libultra/io/pimgr.o(.data);
        build/src/libultra/os/setthreadpri.o(.data);
        build/src/libultra/io/conteepwrite.o(.data);
        build/src/libultra/io/conteepread.o(.data);
        build/src/libultra/io/contreaddata.o(.data);
        build/src/libultra/io/conteepprobe.o(.data);
        build/asm/libultra/os/invaldcache.o(.data);
        build/src/libultra/io/pidma.o(.data);
        build/src/libultra/io/visetspecial.o(.data);
        build/src/libultra/libc/sprintf.o(.data);
        build/src/libultra/io/controller.o(.data);
        build/src/libultra/libc/string.o(.data);
        build/src/libultra/libc/syncprintf.o(.data);
        build/src/libultra/os/stopthread.o(.data);
        build/src/libultra/libc/ll.o(.data);
        build/src/libultra/os/settime.o(.data);
        build/asm/libultra/libc/bzero.o(.data);
        build/src/libultra/gu/cosf.o(.data);
        build/src/libultra/gu/sinf.o(.data);
        build/src/libultra/gu/mtxutil.o(.data);
        build/src/libultra/gu/translate.o(.data);
        build/src/libultra/gu/mtxcatf.o(.data);
        build/src/libultra/gu/rotate.o(.data);
        build/src/libultra/gu/scale.o(.data);
        build/src/libultra/gu/perspective.o(.data);
        build/src/libultra/gu/lookatref.o(.data);
        build/asm/data/C56F0.data.o(.data);
        build/src/libultra/gu/sins.o(.data);
        build/src/libultra/gu/rotaterpy.o(.data);
        build/src/libultra/gu/coss.o(.data);
        build/src/libultra/gu/ortho.o(.data);
        build/asm/libultra/gu/sqrtf.o(.data);
        build/src/libultra/audio/synaddplayer.o(.data);
        build/src/libultra/audio/synallocvoice.o(.data);
        build/src/libultra/audio/synstopvoice.o(.data);
        build/src/libultra/os/jammesg.o(.data);
        build/src/libultra/audio/synsetpan.o(.data);
        build/src/libultra/audio/synstartvoiceparam.o(.data);
        build/src/libultra/audio/synsetpitch.o(.data);
        build/src/libultra/io/aisetfreq.o(.data);
        build/src/libultra/audio/heapalloc.o(.data);
        build/src/libultra/io/aisetnextbuf.o(.data);
        build/src/libultra/io/aigetlen.o(.data);
        build/src/libultra/audio/heapinit.o(.data);
        build/src/libultra/gu/lookat.o(.data);
        build/asm/libultra/os/writebackdcache.o(.data);
        build/src/libultra/os/gettime.o(.data);
        build/src/libultra/audio/syndelete.o(.data);
        build/src/libultra/audio/drvrnew.o(.data);
        build/src/libultra/audio/synallocfx.o(.data);
        build/src/libultra/audio/mainbus.o(.data);
        build/src/libultra/audio/resample.o(.data);
        build/src/libultra/audio/auxbus.o(.data);
        build/src/libultra/audio/save.o(.data);
        build/asm/libultra/os/probetlb.o(.data);
        build/src/libultra/os/thread.o(.data);
        build/src/libultra/os/timerintr.o(.data);
        build/src/libultra/os/getthreadpri.o(.data);
        build/asm/libultra/os/interrupt.o(.data);
        build/src/libultra/io/vi.o(.data);
        build/src/libultra/io/vigetcurrcontext.o(.data);
        build/src/libultra/io/viswapcontext.o(.data);
        build/asm/libultra/os/getcount.o(.data);
        build/asm/libultra/os/exceptasm.o(.data);
        build/src/libultra/io/spgetstat.o(.data);
        build/asm/libultra/libc/bcopy.o(.data);
        build/src/libultra/io/spsetstat.o(.data);
        build/src/libultra/io/spsetpc.o(.data);
        build/src/libultra/io/sprawdma.o(.data);
        build/src/libultra/io/sp.o(.data);
        build/src/libultra/io/dp.o(.data);
        build/asm/libultra/os/setsr.o(.data);
        build/asm/libultra/os/setfpccsr.o(.data);
        build/src/libultra/io/siraw.o(.data);
        build/asm/libultra/os/invalicache.o(.data);
        build/asm/libultra/os/maptlbrdb.o(.data);
        build/src/libultra/io/cartrominit.o(.data);
        build/src/libultra/io/leodiskinit.o(.data);
        build/asm/data/C6140.data.o(.data);
        build/src/libultra/io/piacs.o(.data);
        build/src/libultra/io/pirawdma.o(.data);
        build/src/libultra/io/epirawdma.o(.data);
        build/src/libultra/io/devmgr.o(.data);
        build/src/libultra/io/siacs.o(.data);
        build/src/libultra/io/sirawdma.o(.data);
        build/src/libultra/io/pigetcmdq.o(.data);
        build/src/libultra/libc/xprintf.o(.data);
        build/src/libultra/os/settimer.o(.data);
        build/src/libultra/gu/normalize.o(.data);
        build/src/libultra/io/ai.o(.data);
        build/src/libultra/audio/filter.o(.data);
        build/src/libultra/audio/reverb.o(.data);
        build/src/libultra/audio/load.o(.data);
        build/asm/libultra/os/setcompare.o(.data);
        build/src/libultra/io/leointerrupt.o(.data);
        build/src/libultra/os/destroythread.o(.data);
        build/src/libultra/io/si.o(.data);
        build/src/libultra/os/resetglobalintmask.o(.data);
        build/src/libultra/io/epirawwrite.o(.data);
        build/src/libultra/io/epirawread.o(.data);
        build/src/libultra/os/setglobalintmask.o(.data);
        build/src/libultra/os/yieldthread.o(.data);
        build/asm/data/C61D0.data.o(.data);
        build/src/libultra/libc/xlitob.o(.data);
        build/src/libultra/libc/xldtob.o(.data);
        build/src/libultra/audio/copy.o(.data);
        build/src/libultra/libc/ldiv.o(.data);
        build/asm/ucode.o(.data);
        build/src/n_audio/env.o(.rodata);
        build/src/sched.o(.rodata);
        build/asm/data/C6370.data.o(.data);
        build/src/code_8170.o(.rodata);
        build/asm/data/C7340.data.o(.data);
        build/src/main.o(.rodata);
        build/asm/data/C9230.data.o(.data);
        build/src/code_4D170.o(.rodata);
        build/asm/data/C9450.data.o(.data);
        build/src/code_5B5D0.o(.rodata);
        build/asm/data/C9AFC.data.o(.data);
        build/src/game2.o(.rodata);
        build/asm/data/CC520.data.o(.data);
        build/src/n_audio/synthesizer.o(.rodata);
        build/asm/data/CC550.data.o(.data);
        build/src/libultra/gu/cosf.o(.rodata);
        build/src/libultra/gu/sinf.o(.rodata);
        build/src/libultra/gu/rotate.o(.rodata);
        build/src/libultra/gu/perspective.o(.rodata);
        build/src/libultra/gu/lookatref.o(.rodata);
        build/src/libultra/gu/rotaterpy.o(.rodata);
        build/src/libultra/audio/drvrnew.o(.rodata);
        build/src/libultra/audio/resample.o(.rodata);
        build/asm/data/CC710.data.o(.data);
        build/src/libultra/io/devmgr.o(.rodata);
        build/src/libultra/libc/xprintf.o(.rodata);
        build/asm/data/CC880.data.o(.data);
        build/src/libultra/audio/reverb.o(.rodata);
        build/src/libultra/libc/xldtob.o(.rodata);
        build/asm/data/CC920.data.o(.data);
        . = ALIGN(., 16);
        main_DATA_END = .;
        main_DATA_SIZE = ABSOLUTE(main_DATA_END - main_DATA_START);
        main_RODATA_START = .;
        build/src/boot.o(.rodata);
        build/src/controller.o(.rodata);
        build/src/code_62D0.o(.rodata);
        build/src/util.o(.rodata);
        build/src/rdpinit.o(.rodata);
        build/src/code_54150.o(.rodata);
        build/src/lz.o(.rodata);
        build/src/synsetvol.o(.rodata);
        build/src/audio_engine.o(.rodata);
        build/src/audiomgr.o(.rodata);
        build/src/audio.o(.rodata);
        build/src/rand.o(.rodata);
        build/src/code_AB540.o(.rodata);
        build/asm/code_AB7E0.o(.rodata);
        build/asm/code_AB830.o(.rodata);
        build/asm/code_AB860.o(.rodata);
        build/src/n_audio/sl.o(.rodata);
        build/src/libultra/os/virtualtophysical.o(.rodata);
        build/src/libultra/os/createmesgqueue.o(.rodata);
        build/src/libultra/io/vimgr.o(.rodata);
        build/src/libultra/io/visetmode.o(.rodata);
        build/src/libultra/io/viblack.o(.rodata);
        build/src/libultra/os/seteventmesg.o(.rodata);
        build/src/libultra/io/visetevent.o(.rodata);
        build/src/libultra/os/createthread.o(.rodata);
        build/src/libultra/os/startthread.o(.rodata);
        build/asm/libultra/os/setintmask.o(.rodata);
        build/src/libultra/os/recvmesg.o(.rodata);
        build/src/libultra/os/sendmesg.o(.rodata);
        build/src/libultra/io/sptaskyielded.o(.rodata);
        build/src/libultra/io/vigetcurrframebuf.o(.rodata);
        build/src/libultra/io/vigetnextframebuf.o(.rodata);
        build/src/libultra/io/viswapbuf.o(.rodata);
        build/asm/libultra/os/writebackdcacheall.o(.rodata);
        build/src/libultra/io/sptask.o(.rodata);
        build/src/libultra/io/dpsetnextbuf.o(.rodata);
        build/src/libultra/io/sptaskyield.o(.rodata);
        build/asm/code_AD110.o(.rodata);
        build/src/libultra/os/initialize.o(.rodata);
        build/src/libultra/io/pirawread.o(.rodata);
        build/src/libultra/os/getcurrfaultthread.o(.rodata);
        build/src/libultra/io/pimgr.o(.rodata);
        build/src/libultra/os/setthreadpri.o(.rodata);
        build/src/libultra/io/conteepwrite.o(.rodata);
        build/src/libultra/io/conteepread.o(.rodata);
        build/src/libultra/io/contreaddata.o(.rodata);
        build/src/libultra/io/conteepprobe.o(.rodata);
        build/asm/libultra/os/invaldcache.o(.rodata);
        build/src/libultra/io/pidma.o(.rodata);
        build/src/libultra/io/visetspecial.o(.rodata);
        build/src/libultra/libc/sprintf.o(.rodata);
        build/src/libultra/io/controller.o(.rodata);
        build/src/libultra/libc/string.o(.rodata);
        build/src/libultra/libc/syncprintf.o(.rodata);
        build/src/libultra/os/stopthread.o(.rodata);
        build/src/libultra/libc/ll.o(.rodata);
        build/src/libultra/os/settime.o(.rodata);
        build/asm/libultra/libc/bzero.o(.rodata);
        build/src/libultra/gu/mtxutil.o(.rodata);
        build/src/libultra/gu/translate.o(.rodata);
        build/src/libultra/gu/mtxcatf.o(.rodata);
        build/src/libultra/gu/scale.o(.rodata);
        build/src/libultra/gu/sins.o(.rodata);
        build/src/libultra/gu/coss.o(.rodata);
        build/src/libultra/gu/ortho.o(.rodata);
        build/asm/libultra/gu/sqrtf.o(.rodata);
        build/src/libultra/audio/synaddplayer.o(.rodata);
        build/src/libultra/audio/synallocvoice.o(.rodata);
        build/src/libultra/audio/synstopvoice.o(.rodata);
        build/src/libultra/os/jammesg.o(.rodata);
        build/src/libultra/audio/synsetpan.o(.rodata);
        build/src/libultra/audio/synstartvoiceparam.o(.rodata);
        build/src/libultra/audio/synsetpitch.o(.rodata);
        build/src/libultra/io/aisetfreq.o(.rodata);
        build/src/libultra/audio/heapalloc.o(.rodata);
        build/src/libultra/io/aisetnextbuf.o(.rodata);
        build/src/libultra/io/aigetlen.o(.rodata);
        build/src/libultra/audio/heapinit.o(.rodata);
        build/src/libultra/gu/lookat.o(.rodata);
        build/asm/libultra/os/writebackdcache.o(.rodata);
        build/src/libultra/os/gettime.o(.rodata);
        build/src/libultra/audio/syndelete.o(.rodata);
        build/src/libultra/audio/synallocfx.o(.rodata);
        build/src/libultra/audio/mainbus.o(.rodata);
        build/src/libultra/audio/auxbus.o(.rodata);
        build/src/libultra/audio/save.o(.rodata);
        build/asm/libultra/os/probetlb.o(.rodata);
        build/src/libultra/os/thread.o(.rodata);
        build/src/libultra/os/timerintr.o(.rodata);
        build/src/libultra/os/getthreadpri.o(.rodata);
        build/asm/libultra/os/interrupt.o(.rodata);
        build/src/libultra/io/vi.o(.rodata);
        build/src/libultra/io/vigetcurrcontext.o(.rodata);
        build/src/libultra/io/viswapcontext.o(.rodata);
        build/asm/libultra/os/getcount.o(.rodata);
        build/asm/libultra/os/exceptasm.o(.rodata);
        build/src/libultra/io/spgetstat.o(.rodata);
        build/asm/libultra/libc/bcopy.o(.rodata);
        build/src/libultra/io/spsetstat.o(.rodata);
        build/src/libultra/io/spsetpc.o(.rodata);
        build/src/libultra/io/sprawdma.o(.rodata);
        build/src/libultra/io/sp.o(.rodata);
        build/src/libultra/io/dp.o(.rodata);
        build/asm/libultra/os/setsr.o(.rodata);
        build/asm/libultra/os/setfpccsr.o(.rodata);
        build/src/libultra/io/siraw.o(.rodata);
        build/asm/libultra/os/invalicache.o(.rodata);
        build/asm/libultra/os/maptlbrdb.o(.rodata);
        build/src/libultra/io/cartrominit.o(.rodata);
        build/src/libultra/io/leodiskinit.o(.rodata);
        build/src/libultra/io/piacs.o(.rodata);
        build/src/libultra/io/pirawdma.o(.rodata);
        build/src/libultra/io/epirawdma.o(.rodata);
        build/src/libultra/io/siacs.o(.rodata);
        build/src/libultra/io/sirawdma.o(.rodata);
        build/src/libultra/io/pigetcmdq.o(.rodata);
        build/src/libultra/os/settimer.o(.rodata);
        build/src/libultra/gu/normalize.o(.rodata);
        build/src/libultra/io/ai.o(.rodata);
        build/src/libultra/audio/filter.o(.rodata);
        build/src/libultra/audio/load.o(.rodata);
        build/asm/libultra/os/setcompare.o(.rodata);
        build/src/libultra/io/leointerrupt.o(.rodata);
        build/src/libultra/os/destroythread.o(.rodata);
        build/src/libultra/io/si.o(.rodata);
        build/src/libultra/os/resetglobalintmask.o(.rodata);
        build/src/libultra/io/epirawwrite.o(.rodata);
        build/src/libultra/io/epirawread.o(.rodata);
        build/src/libultra/os/setglobalintmask.o(.rodata);
        build/src/libultra/os/yieldthread.o(.rodata);
        build/src/libultra/libc/xlitob.o(.rodata);
        build/src/libultra/audio/copy.o(.rodata);
        build/src/libultra/libc/ldiv.o(.rodata);
        build/asm/ucode.o(.rodata);
        build/src/code_1050.o(.rodata);
        . = ALIGN(., 16);
        main_RODATA_END = .;
        main_RODATA_SIZE = ABSOLUTE(main_RODATA_END - main_RODATA_START);
    }
    main_bss_VRAM = ADDR(.main_bss);
    .main_bss (NOLOAD) : SUBALIGN(4)
    {
        FILL(0x00000000);
        main_BSS_START = .;
        build/src/code_1050.o(.bss);
        build/src/n_audio/env.o(.bss);
        build/src/sched.o(.bss);
        build/src/controller.o(.bss);
        build/src/code_62D0.o(.bss);
        build/src/code_8170.o(.bss);
        build/src/util.o(.bss);
        build/src/rdpinit.o(.bss);
        build/src/main.o(.bss);
        build/src/code_4D170.o(.bss);
        build/src/code_54150.o(.bss);
        build/src/lz.o(.bss);
        build/src/synsetvol.o(.bss);
        build/src/audio_engine.o(.bss);
        build/src/audiomgr.o(.bss);
        build/src/audio.o(.bss);
        build/src/code_5B5D0.o(.bss);
        build/src/rand.o(.bss);
        build/src/boot_state.o(.bss);
        build/src/boot.o(.bss);
        build/asm/data/game_bss_before_pi.bss.o(.bss);
        build/src/pi_state.o(.bss);
        build/asm/data/game_bss.bss.o(.bss);
        build/src/game2.o(.bss);
        build/src/code_AB540.o(.bss);
        build/asm/code_AB7E0.o(.bss);
        build/asm/code_AB830.o(.bss);
        build/asm/code_AB860.o(.bss);
        build/src/n_audio/sl.o(.bss);
        build/src/n_audio/synthesizer.o(.bss);
        build/src/libultra/os/virtualtophysical.o(.bss);
        build/src/libultra/os/createmesgqueue.o(.bss);
        build/asm/data/game_bss_b.bss.o(.bss);
        build/src/libultra/io/vimgr.o(.bss);
        build/src/libultra/io/visetmode.o(.bss);
        build/src/libultra/io/viblack.o(.bss);
        build/src/libultra/io/visetevent.o(.bss);
        build/src/libultra/os/createthread.o(.bss);
        build/src/libultra/os/startthread.o(.bss);
        build/asm/libultra/os/setintmask.o(.bss);
        build/src/libultra/os/recvmesg.o(.bss);
        build/src/libultra/os/sendmesg.o(.bss);
        build/src/libultra/io/sptaskyielded.o(.bss);
        build/src/libultra/io/vigetcurrframebuf.o(.bss);
        build/src/libultra/io/vigetnextframebuf.o(.bss);
        build/src/libultra/io/viswapbuf.o(.bss);
        build/asm/libultra/os/writebackdcacheall.o(.bss);
        build/src/libultra/os/seteventmesg.o(.bss);
        build/src/libultra/io/sptask.o(.bss);
        build/src/libultra/io/dpsetnextbuf.o(.bss);
        build/src/libultra/io/sptaskyield.o(.bss);
        build/asm/code_AD110.o(.bss);
        build/src/libultra/os/initialize.o(.bss);
        build/src/libultra/io/pirawread.o(.bss);
        build/src/libultra/os/getcurrfaultthread.o(.bss);
        build/src/libultra/io/pimgr.o(.bss);
        build/src/libultra/os/setthreadpri.o(.bss);
        build/src/libultra/io/conteepwrite.o(.bss);
        build/src/libultra/io/contreaddata.o(.bss);
        build/src/libultra/io/conteepprobe.o(.bss);
        build/asm/libultra/os/invaldcache.o(.bss);
        build/src/libultra/io/pidma.o(.bss);
        build/src/libultra/io/visetspecial.o(.bss);
        build/src/libultra/libc/sprintf.o(.bss);
        build/src/libultra/libc/string.o(.bss);
        build/src/libultra/libc/syncprintf.o(.bss);
        build/src/libultra/os/stopthread.o(.bss);
        build/src/libultra/libc/ll.o(.bss);
        build/src/libultra/os/settime.o(.bss);
        build/asm/libultra/libc/bzero.o(.bss);
        build/src/libultra/gu/cosf.o(.bss);
        build/src/libultra/gu/sinf.o(.bss);
        build/src/libultra/gu/mtxutil.o(.bss);
        build/src/libultra/gu/translate.o(.bss);
        build/src/libultra/gu/mtxcatf.o(.bss);
        build/src/libultra/io/conteepread.o(.bss);
        build/src/libultra/io/controller.o(.bss);
        build/src/libultra/gu/rotate.o(.bss);
        build/src/libultra/gu/scale.o(.bss);
        build/src/libultra/gu/perspective.o(.bss);
        build/src/libultra/gu/lookatref.o(.bss);
        build/src/libultra/gu/sins.o(.bss);
        build/src/libultra/gu/rotaterpy.o(.bss);
        build/src/libultra/gu/coss.o(.bss);
        build/src/libultra/gu/ortho.o(.bss);
        build/asm/libultra/gu/sqrtf.o(.bss);
        build/src/libultra/audio/synaddplayer.o(.bss);
        build/src/libultra/audio/synallocvoice.o(.bss);
        build/src/libultra/audio/synstopvoice.o(.bss);
        build/src/libultra/os/jammesg.o(.bss);
        build/src/libultra/audio/synsetpan.o(.bss);
        build/src/libultra/audio/synstartvoiceparam.o(.bss);
        build/src/libultra/audio/synsetpitch.o(.bss);
        build/src/libultra/io/aisetfreq.o(.bss);
        build/src/libultra/audio/heapalloc.o(.bss);
        build/src/libultra/io/aisetnextbuf.o(.bss);
        build/src/libultra/io/aigetlen.o(.bss);
        build/src/libultra/audio/heapinit.o(.bss);
        build/src/libultra/gu/lookat.o(.bss);
        build/asm/libultra/os/writebackdcache.o(.bss);
        build/src/libultra/os/gettime.o(.bss);
        build/src/libultra/audio/syndelete.o(.bss);
        build/src/libultra/audio/drvrnew.o(.bss);
        build/src/libultra/audio/synallocfx.o(.bss);
        build/src/libultra/audio/mainbus.o(.bss);
        build/src/libultra/audio/resample.o(.bss);
        build/src/libultra/audio/auxbus.o(.bss);
        build/src/libultra/audio/save.o(.bss);
        build/asm/libultra/os/probetlb.o(.bss);
        build/src/libultra/os/thread.o(.bss);
        build/src/libultra/os/timerintr.o(.bss);
        build/src/libultra/os/getthreadpri.o(.bss);
        build/asm/libultra/os/interrupt.o(.bss);
        build/src/libultra/io/vi.o(.bss);
        build/src/libultra/io/vigetcurrcontext.o(.bss);
        build/src/libultra/io/viswapcontext.o(.bss);
        build/asm/libultra/os/getcount.o(.bss);
        build/asm/libultra/os/exceptasm.o(.bss);
        build/src/libultra/io/spgetstat.o(.bss);
        build/asm/libultra/libc/bcopy.o(.bss);
        build/src/libultra/io/spsetstat.o(.bss);
        build/src/libultra/io/spsetpc.o(.bss);
        build/src/libultra/io/sprawdma.o(.bss);
        build/src/libultra/io/sp.o(.bss);
        build/src/libultra/io/dp.o(.bss);
        build/asm/libultra/os/setsr.o(.bss);
        build/asm/libultra/os/setfpccsr.o(.bss);
        build/src/libultra/io/siraw.o(.bss);
        build/asm/libultra/os/invalicache.o(.bss);
        build/asm/libultra/os/maptlbrdb.o(.bss);
        build/src/libultra/io/cartrominit.o(.bss);
        build/src/libultra/io/leodiskinit.o(.bss);
        build/src/libultra/io/piacs.o(.bss);
        build/src/libultra/io/pirawdma.o(.bss);
        build/src/libultra/io/epirawdma.o(.bss);
        build/src/libultra/io/devmgr.o(.bss);
        build/src/libultra/io/siacs.o(.bss);
        build/src/libultra/io/sirawdma.o(.bss);
        build/src/libultra/io/pigetcmdq.o(.bss);
        build/src/libultra/libc/xprintf.o(.bss);
        build/src/libultra/os/settimer.o(.bss);
        build/src/libultra/gu/normalize.o(.bss);
        build/src/libultra/io/ai.o(.bss);
        build/src/libultra/audio/filter.o(.bss);
        build/src/libultra/audio/reverb.o(.bss);
        build/src/libultra/audio/load.o(.bss);
        build/asm/libultra/os/setcompare.o(.bss);
        build/src/libultra/debug/kdebugserver.o(.bss);
        build/src/libultra/io/leointerrupt.o(.bss);
        build/src/libultra/os/destroythread.o(.bss);
        build/src/libultra/io/si.o(.bss);
        build/src/libultra/os/resetglobalintmask.o(.bss);
        build/src/libultra/io/epirawwrite.o(.bss);
        build/src/libultra/io/epirawread.o(.bss);
        build/src/libultra/os/setglobalintmask.o(.bss);
        build/src/libultra/os/yieldthread.o(.bss);
        build/src/libultra/libc/xlitob.o(.bss);
        build/src/libultra/libc/xldtob.o(.bss);
        build/src/libultra/audio/copy.o(.bss);
        build/src/libultra/libc/ldiv.o(.bss);
        build/asm/ucode.o(.bss);
        build/asm/data/os_bss_f.bss.o(.bss);
        . = ALIGN(., 16);
        main_BSS_END = .;
        main_BSS_SIZE = ABSOLUTE(main_BSS_END - main_BSS_START);
    }
    __romPos += SIZEOF(.main);
    __romPos = ALIGN(__romPos, 16);
    . = ALIGN(., 16);
    main_ROM_END = __romPos;
    main_VRAM_END = .;

    CD3F0_ROM_START = __romPos;
    CD3F0_VRAM = ADDR(.CD3F0);
    .CD3F0 main_VRAM_END : AT(CD3F0_ROM_START) SUBALIGN(16)
    {
        FILL(0x00000000);
        CD3F0_DATA_START = .;
        build/assets/CD3F0.o(.data);
        CD3F0_DATA_END = .;
        CD3F0_DATA_SIZE = ABSOLUTE(CD3F0_DATA_END - CD3F0_DATA_START);
    }
    __romPos += SIZEOF(.CD3F0);
    CD3F0_ROM_END = __romPos;
    CD3F0_VRAM_END = .;

    /DISCARD/ :
    {
        *(*);
    }
}
